## CMakeLists.txt
```
# SPDX-FileCopyrightText: <text>Copyright (c) 2026 Infineon Technologies AG,
# or an affiliate of Infineon Technologies AG. All rights reserved.</text>
#
# SPDX-License-Identifier: Apache-2.0

cmake_minimum_required(VERSION 3.20.0)

find_package(Zephyr REQUIRED HINTS $ENV{ZEPHYR_BASE})
project(lp_cpu_sensor)

target_sources(app PRIVATE src/main.c src/cycfg_peripherals.c)
target_include_directories(app PRIVATE src)
```

## sample.yaml
```
# SPDX-FileCopyrightText: <text>Copyright (c) 2026 Infineon Technologies AG,
# or an affiliate of Infineon Technologies AG. All rights reserved.</text>
#
# SPDX-License-Identifier: Apache-2.0

sample:
  name: AutAnalog low-power die temperature sensor sample
common:
  tags:
    - adc
    - sensor
  depends_on:
    - adc
  filter: dt_node_has_prop("/zephyr,user","io-channels")

tests:
  sample.boards.infineon.autanalog.lp_temp_sensor:
    platform_allow:
      - kit_pse84_eval/pse846gps2dbzc4a/m55
    integration_platforms:
      - kit_pse84_eval/pse846gps2dbzc4a/m55
    harness: console
    timeout: 30
    harness_config:
      type: multi_line
      regex:
        - "AutAnalog LP die temperature sensor sample"
        - "ADC ready"
        - "ADC Count = \\d+; Temperature \\(degree C\\) = \\d+"
```

## prj.conf
```kconfig
# SPDX-FileCopyrightText: <text>Copyright (c) 2026 Infineon Technologies AG,
# or an affiliate of Infineon Technologies AG. All rights reserved.</text>
#
# SPDX-License-Identifier: Apache-2.0

CONFIG_ADC=y
```

## src/main.c
```c
/*
 * SPDX-FileCopyrightText: <text>Copyright (c) 2026 Infineon Technologies AG,
 * or an affiliate of Infineon Technologies AG. All rights reserved.</text>
 *
 * SPDX-License-Identifier: Apache-2.0
 */

/*
 * Low-power autonomous analog audio sample.
 *
 * Uses the autonomous analog in low power mode to detect acoustic
 * activity and prints the detected audio frame to the console.
 *
 *   1. CTB0 OA0 amplifies the analog microphone signal.
 *   2. PTCOMP comparators perform Acoustic Activity Detection (AAD)
 *      by comparing the preamp output against two PRB reference
 *      voltages.
 *   3. The SAR ADC samples the preamp output in LP mode through an
 *      internal MUX channel.  Results are collected in a 512-word
 *      FIFO; a watermark interrupt fires every 160 samples (~10 ms).
 *   4. The AC state machine is started by ifx_autanalog_fw_trigger().
 *   5. Audio frame statistics are printed to the console using the
 *      ADC stream API (RTIO-based).
 */

#include <inttypes.h>
#include <stdint.h>

#include <zephyr/kernel.h>
#include <zephyr/rtio/rtio.h>
#include <zephyr/sys/printk.h>
#include <zephyr/sys/util.h>
#include <cycfg_peripherals.h>

#define ADC_SCAN_DELAY_MSEC         (500U)
#define SAR_ADC_INDEX               (0U)
#define SAR_ADC_SEQENCER            (0U)
#define SAR_ADC_CHANNEL             (0U)
#define SAR_ADC_VREF_MV             (1800U)

int main(void)
{
    uint32_t result;
    int32_t sar_adc_count;
    int16_t chipTemp;
    uint8_t  sarIdx       = 0U;
    uint8_t  sarSequencer = 0U;
    uint8_t  sarChannel   = 0U;
    uint32_t VrefmV       = 900U; /* Vbgr = 0.9V */

    /* Initialize SAR ADC */
    result = Cy_AutAnalog_Init(&autonomous_analog_init);
    if (CY_AUTANALOG_SUCCESS != result)
    {
 	    printf("init error\r\n");
    }

    // the following workarount for B0 slicon to unload bandgap trimming data as temp sensor was trimming based on untrimmed bandgap
	INFRA->AREF.VREF_TRIM1 = 0U;
	INFRA->AREF.VREF_TRIM2 = 0U;

    /* Start autonomous control of the ADC */
    Cy_AutAnalog_StartAutonomousControl();



    /* Read ADC result */
	while(1){

		
	    sar_adc_count = Cy_AutAnalog_SAR_ReadResult(SAR_ADC_INDEX,
												    CY_AUTANALOG_SAR_INPUT_MUX,
	                                                SAR_ADC_CHANNEL);

	
	    /* Convert ADC counts to temperaturue */
        chipTemp = Cy_AutAnalog_SAR_CountsTo_degreeC(SAR_ADC_INDEX, true, 
                                                     SAR_ADC_SEQENCER, 
                                                     SAR_ADC_CHANNEL, 
                                                     sar_adc_count);
 	
	    /* Print ADC output in millivolts */
	    printf("ADC Count = %d; Temperature (degree C) = %d\r\n", sar_adc_count, chipTemp);

		k_msleep(500);
	}


	return 0;
}
```

## src/cycfg_peripherals.c
```c
/*******************************************************************************
 * File Name: cycfg_peripherals.c
 *
 * Description:
 * Analog configuration
 * This file was automatically generated and should not be modified.
 * Configurator Backend 3.70.0
 * device-db 4.34.0.9502
 * mtb-dsl-pse8xxgp 1.2.0.895
 *
 *******************************************************************************
 * Copyright 2026 Cypress Semiconductor Corporation (an Infineon company) or
 * an affiliate of Cypress Semiconductor Corporation.
 * SPDX-License-Identifier: Apache-2.0
 *
 * Licensed under the Apache License, Version 2.0 (the "License");
 * you may not use this file except in compliance with the License.
 * You may obtain a copy of the License at
 *
 *     http://www.apache.org/licenses/LICENSE-2.0
 *
 * Unless required by applicable law or agreed to in writing, software
 * distributed under the License is distributed on an "AS IS" BASIS,
 * WITHOUT WARRANTIES OR CONDITIONS OF ANY KIND, either express or implied.
 * See the License for the specific language governing permissions and
 * limitations under the License.
 ******************************************************************************/

#include <cycfg_peripherals.h>
#include "cy_autanalog_sar.h"
#include "cy_autanalog.h"

#define CYBSP_GENERAL_PURPOSE_TIMER_INPUT_DISABLED 0x7U
#define emUSB_OS_Timer_INPUT_DISABLED 0x7U
#define CYBSP_GENERAL_PURPOSE_TIMER_2_INPUT_DISABLED 0x7U
#define CYBSP_PWM_LED_CTRL_INPUT_DISABLED 0x7U
#define CYBSP_SMARTIO_PWM_INPUT_DISABLED 0x7U

cy_stc_autanalog_cfg_t autonomous_analog_cfg =
{
    .prb = NULL,
    .ac = &CYBSP_AUTONOMOUS_CONTROLLER_cfg,

    .sar =
    {
        &CYBSP_SAR_ADC_cfg, 
    },
};
cy_stc_autanalog_stt_t autonomous_analog_stt[] =
{
    {
        .ac = &CYBSP_AUTONOMOUS_CONTROLLER_stt[0U],
        .prb = NULL,

        .sar =
        {
            &CYBSP_SAR_ADC_stt[0U], 
        },
    },
    {
        .ac = &CYBSP_AUTONOMOUS_CONTROLLER_stt[1U],
        .prb = NULL,

        .sar =
        {
            &CYBSP_SAR_ADC_stt[1U], 
        },
    },
    {
        .ac = &CYBSP_AUTONOMOUS_CONTROLLER_stt[2U],
        .prb = NULL,

        .sar =
        {
            &CYBSP_SAR_ADC_stt[2U], 
        },
    },
};
cy_stc_autanalog_t autonomous_analog_init =
{
    .configuration = &autonomous_analog_cfg,
    .numSttEntries = sizeof(autonomous_analog_stt)/sizeof(autonomous_analog_stt[0U]),
    .stateTransitionTable = &autonomous_analog_stt[0U],
};
cy_en_autanalog_ac_out_trigger_mask_t CYBSP_AUTONOMOUS_CONTROLLER_out_trig_mask[] =
{
    CY_AUTANALOG_AC_OUT_TRIG_MASK_EMPTY, 
    CY_AUTANALOG_AC_OUT_TRIG_MASK_EMPTY, 
    CY_AUTANALOG_AC_OUT_TRIG_MASK_EMPTY, 
    CY_AUTANALOG_AC_OUT_TRIG_MASK_EMPTY, 
    CY_AUTANALOG_AC_OUT_TRIG_MASK_EMPTY, 
    CY_AUTANALOG_AC_OUT_TRIG_MASK_EMPTY, 
    CY_AUTANALOG_AC_OUT_TRIG_MASK_EMPTY, 
    CY_AUTANALOG_AC_OUT_TRIG_MASK_EMPTY, 
};
cy_stc_autanalog_ac_t CYBSP_AUTONOMOUS_CONTROLLER_cfg =
{
    .gpioOutEn =  
 CY_AUTANALOG_STT_AC_GPIO_OUT_DISABLED,
    .mask =
    {
        &CYBSP_AUTONOMOUS_CONTROLLER_out_trig_mask[0U], 
        &CYBSP_AUTONOMOUS_CONTROLLER_out_trig_mask[1U], 
        &CYBSP_AUTONOMOUS_CONTROLLER_out_trig_mask[2U], 
        &CYBSP_AUTONOMOUS_CONTROLLER_out_trig_mask[3U], 
        &CYBSP_AUTONOMOUS_CONTROLLER_out_trig_mask[4U], 
        &CYBSP_AUTONOMOUS_CONTROLLER_out_trig_mask[5U], 
        &CYBSP_AUTONOMOUS_CONTROLLER_out_trig_mask[6U], 
        &CYBSP_AUTONOMOUS_CONTROLLER_out_trig_mask[7U], 
    },
    .timer =
    {
        .enable = false,
        .clkSrc = CY_AUTANALOG_TIMER_CLK_LP,
        .period = 0U,
    },
};
cy_stc_autanalog_stt_ac_t CYBSP_AUTONOMOUS_CONTROLLER_stt[] =
{
    {
        .unlock = true,
        .lpMode = true,
        .condition = CY_AUTANALOG_STT_AC_CONDITION_BLOCK_READY,
        .action = CY_AUTANALOG_STT_AC_ACTION_WAIT_FOR,
        .branchState = 1U,
        .trigInt = false,
        .count = 0U,
        .unlockGpioOut = false,
        .gpioOut = CY_AUTANALOG_STT_AC_GPIO_OUT_DISABLED,
    },
    {
        .unlock = false,
        .lpMode = false,
        .condition = CY_AUTANALOG_STT_AC_CONDITION_SAR_DONE,
        .action = CY_AUTANALOG_STT_AC_ACTION_WAIT_FOR,
        .branchState = 0U,
        .trigInt = false,
        .count = 0U,
        .unlockGpioOut = false,
        .gpioOut = CY_AUTANALOG_STT_AC_GPIO_OUT_DISABLED,
    },
    {
        .unlock = false,
        .lpMode = false,
        .condition = CY_AUTANALOG_STT_AC_CONDITION_FALSE,
        .action = CY_AUTANALOG_STT_AC_ACTION_STOP,
        .branchState = 0U,
        .trigInt = false,
        .count = 0U,
        .unlockGpioOut = false,
        .gpioOut = CY_AUTANALOG_STT_AC_GPIO_OUT_DISABLED,
    },
};
cy_stc_autanalog_sar_mux_chan_t CYBSP_SAR_ADC_mux_ch_cfg[] =
{
    {
        .posPin = CY_AUTANALOG_SAR_PIN_MUX_TEMP_SENSOR,
        .sign = true,
        .posCoeff = CY_AUTANALOG_SAR_CH_COEFF_DISABLED,
        .negPin = CY_AUTANALOG_SAR_PIN_MUX_TEMP_SENSOR,
        .buffBypass = false,
        .accShift = true,
        .negCoeff = CY_AUTANALOG_SAR_CH_COEFF_DISABLED,
        .muxLimit = CY_AUTANALOG_SAR_LIMIT_STATUS_DISABLED,
        .fifoSel = CY_AUTANALOG_FIFO_DISABLED,
    },
};
cy_stc_autanalog_sar_sta_lp_t CYBSP_SAR_ADC_sta_lp_cfg =
{
    .lpDiffEn = true,
    .lpVref = CY_AUTANALOG_SAR_VREF_VBGR,
    .lpSampleTime =
    {
        5U, 
        5U, 
        5U, 
        5U, 
    },
};
cy_stc_autanalog_sar_sta_t CYBSP_SAR_ADC_sta_cfg =
{
    .lpStaCfg = &CYBSP_SAR_ADC_sta_lp_cfg,
    .hsStaCfg = NULL,
    .posBufPwr = CY_AUTANALOG_SAR_BUF_PWR_ULTRA_LOW_RAIL,
    .negBufPwr = CY_AUTANALOG_SAR_BUF_PWR_ULTRA_LOW,
    .accMode = CY_AUTANALOG_SAR_ACC_ACCUNDUMP,
    .startupCal = CY_AUTANALOG_SAR_CAL_DISABLED,
    .chanID = false,
    .shiftMode = true,
    .intMuxChan =
    {
        &CYBSP_SAR_ADC_mux_ch_cfg[0U], 
        NULL, 
        NULL, 
        NULL, 
        NULL, 
        NULL, 
        NULL, 
        NULL, 
        NULL, 
        NULL, 
        NULL, 
        NULL, 
        NULL, 
        NULL, 
        NULL, 
        NULL, 
    },
    .limitCond =
    {
        NULL, 
        NULL, 
        NULL, 
        NULL, 
    },
    .muxResultMask =  
 CY_AUTANALOG_SAR_CHAN_MASK_MUX0,
    .firResultMask =  
 CY_AUTANALOG_SAR_MASK_FIR_DISABLED,
};
cy_stc_autanalog_sar_seq_tab_lp_t CYBSP_SAR_ADC_seq_lp_cfg[] =
{
    {
        .chanEn = true,
        .mux0Sel = CY_AUTANALOG_SAR_CHAN_CFG_MUX0,
        .sampleTimeEn = true,
        .sampleTime = CY_AUTANALOG_SAR_SAMPLE_TIME0,
        .accEn = true,
        .accCount = CY_AUTANALOG_SAR_ACC_CNT32,
        .calReq = CY_AUTANALOG_SAR_CAL_DISABLED,
        .nextAction = CY_AUTANALOG_SAR_NEXT_ACTION_GO_TO_ENTRY_ADDR,
    },
};
cy_stc_autanalog_sar_t CYBSP_SAR_ADC_cfg =
{
    .sarStaCfg = &CYBSP_SAR_ADC_sta_cfg,
    .hsSeqTabNum = 0U,
    .hsSeqTabArr = NULL,
    .lpSeqTabNum = sizeof(CYBSP_SAR_ADC_seq_lp_cfg)/sizeof(CYBSP_SAR_ADC_seq_lp_cfg[0U]),
    .lpSeqTabArr = &CYBSP_SAR_ADC_seq_lp_cfg[0U],
    .firNum = 0U,
    .firCfg = NULL,
    .fifoCfg = NULL,
};
cy_stc_autanalog_stt_sar_t CYBSP_SAR_ADC_stt[] =
{
    {
        .unlock = true,
        .enable = true,
        .trigger = false,
        .entryState = 0U,
    },
    {
        .unlock = true,
        .enable = true,
        .trigger = true,
        .entryState = 0U,
    },
    {
        .unlock = true,
        .enable = true,
        .trigger = false,
        .entryState = 0U,
    },
};
```

## src/cycfg_peripherals.h
```c
/*******************************************************************************
 * File Name: cycfg_peripherals.h
 *
 * Description:
 * Analog configuration
 * This file was automatically generated and should not be modified.
 * Configurator Backend 3.70.0
 * device-db 4.34.0.9502
 * mtb-dsl-pse8xxgp 1.2.0.895
 *
 *******************************************************************************
 * Copyright 2026 Cypress Semiconductor Corporation (an Infineon company) or
 * an affiliate of Cypress Semiconductor Corporation.
 * SPDX-License-Identifier: Apache-2.0
 *
 * Licensed under the Apache License, Version 2.0 (the "License");
 * you may not use this file except in compliance with the License.
 * You may obtain a copy of the License at
 *
 *     http://www.apache.org/licenses/LICENSE-2.0
 *
 * Unless required by applicable law or agreed to in writing, software
 * distributed under the License is distributed on an "AS IS" BASIS,
 * WITHOUT WARRANTIES OR CONDITIONS OF ANY KIND, either express or implied.
 * See the License for the specific language governing permissions and
 * limitations under the License.
 ******************************************************************************/

#if !defined(CYCFG_PERIPHERALS_H)
#define CYCFG_PERIPHERALS_H

#include <infineon_kconfig.h>
#include <zephyr/device.h>

#include <infineon_autanalog.h>

#include "cy_pdl.h"
#include "cy_autanalog.h"
#include "cy_autanalog_sar.h"

#define CYBSP_AUTONOMOUS_ANALOG_ENABLED 1U
#define CYBSP_AUTONOMOUS_ANALOG_lppass_IRQ pass_interrupt_lppass_IRQn
#define CYBSP_AUTONOMOUS_ANALOG_fifo_IRQ pass_interrupt_fifo_IRQn
#define CYBSP_AUTONOMOUS_CONTROLLER_ENABLED 1U
#define CYBSP_SAR_ADC_ENABLED 1U
#define CYBSP_AUTONOMOUS_CONTROLLER_STATE_0_ENABLED 1U
#define CYBSP_AUTONOMOUS_CONTROLLER_STATE_1_ENABLED 1U
#define CYBSP_AUTONOMOUS_CONTROLLER_STATE_2_ENABLED 1U
#define CYBSP_SAR_ADC_SCAN_GRP_0_ENABLED 1U
#define temp_sensor_mx_ENABLED 1U
#define CYBSP_SAR_ADC_SCAN_GRP_0_SCAN_0_ENABLED 1U

extern cy_stc_autanalog_cfg_t autonomous_analog_cfg;
extern cy_stc_autanalog_stt_t autonomous_analog_stt[];
extern cy_stc_autanalog_t autonomous_analog_init;
extern cy_en_autanalog_ac_out_trigger_mask_t CYBSP_AUTONOMOUS_CONTROLLER_out_trig_mask[];
extern cy_stc_autanalog_ac_t CYBSP_AUTONOMOUS_CONTROLLER_cfg;
extern cy_stc_autanalog_stt_ac_t CYBSP_AUTONOMOUS_CONTROLLER_stt[];
extern cy_stc_autanalog_sar_mux_chan_t CYBSP_SAR_ADC_mux_ch_cfg[];
extern cy_stc_autanalog_sar_sta_lp_t CYBSP_SAR_ADC_sta_lp_cfg;
extern cy_stc_autanalog_sar_sta_t CYBSP_SAR_ADC_sta_cfg;
extern cy_stc_autanalog_sar_seq_tab_lp_t CYBSP_SAR_ADC_seq_lp_cfg[];
extern cy_stc_autanalog_sar_t CYBSP_SAR_ADC_cfg;
extern cy_stc_autanalog_stt_sar_t CYBSP_SAR_ADC_stt[];




#endif /* CYCFG_PERIPHERALS_H */
```
