## CMakeLists.txt
```
# Copyright (c) 2025 Infineon Technologies AG,
# or an affiliate of Infineon Technologies AG.
#
# SPDX-License-Identifier: Apache-2.0

cmake_minimum_required(VERSION 3.20.0)

message(STATUS "${BOARD} compile as Main in this sample")

find_package(Zephyr REQUIRED HINTS $ENV{ZEPHYR_BASE})

project(mbox_ipc)

enable_language(C ASM)

target_sources(app PRIVATE src/main.c)
```

## Kconfig
```
# Copyright (c) 2025 Infineon Technologies AG,
# or an affiliate of Infineon Technologies AG.
#
# SPDX-License-Identifier: Apache-2.0

mainmenu "Infineon CAT1 MBOX sample application"

source "Kconfig.zephyr"
```

## sample.yaml
```
# Copyright (c) 2025 Infineon Technologies AG,
# or an affiliate of Infineon Technologies AG.
#
# SPDX-License-Identifier: Apache-2.0

sample:
  name: Infineon CAT1 MBOX
tests:
  sample.board.infineon.mbox:
    platform_allow:
      - cy8cproto_062_4343w
      - kit_pse84_eval/pse846gps2dbzc4a/m33/ns
      - kit_pse84_eval/pse846gps2dbzc4a/m55
    tags: mbox
    harness: console
    harness_config:
      type: multi_line
      regex:
        - "Ping (on channel 1)"
        - "Pong (on channel 0 [data 1, 4])"
        - "Ping (on channel 1)"
        - "Pong (on channel 0 [data 2, 4])"
        - "Ping (on channel 1)"
        - "Pong (on channel 0 [data 3, 4])"
    filter: dt_compat_enabled("infineon,mbox-pipe")
```

## prj.conf
```kconfig
# Copyright (c) 2025 Infineon Technologies AG,
# or an affiliate of Infineon Technologies AG.
#
# SPDX-License-Identifier: Apache-2.0

CONFIG_PRINTK=y
CONFIG_MBOX=y
```

## boards/kit_pse84_eval_common.overlay
```dts
/*
 * Copyright (c) 2025 Infineon Technologies AG,
 * or an affiliate of Infineon Technologies AG.
 *
 * SPDX-License-Identifier: Apache-2.0
 */

&ipc0 {
	status = "okay";

	mbox0: mbox0 {
		#mbox-cells = <1>;
		compatible = "infineon,mbox-pipe";
		ipc-pipe-ep0-addr = <1>;
		ipc-pipe-ep1-addr = <2>;

		ipc-configs =  <&ipc0 4 4 4>, /* IPC config for EP0 */
				       <&ipc0 5 5 4>; /* IPC config for EP1 */
		status = "okay";
	};
};
```

## src/main.c
```c
/*
 * Copyright (c) 2025 Infineon Technologies AG,
 * or an affiliate of Infineon Technologies AG.
 *
 * SPDX-License-Identifier: Apache-2.0
 */

#include <stdio.h>
#include <stdlib.h>
#include <zephyr/kernel.h>
#include <zephyr/drivers/mbox.h>

#if defined(CONFIG_CPU_CORTEX_M4) || defined(CONFIG_CPU_CORTEX_M55)
#define TX_ID (1)
#define RX_ID (0)
bool coreA = true;

#else
#define TX_ID (0)
#define RX_ID (1)
bool coreA;

#endif /* #if CONFIG_CPU_CORTEX_M4 || CONFIG_CPU_CORTEX_M55 */

static void rx_callback(const struct device *dev, uint32_t channel, void *user_data,
			struct mbox_msg *data)
{
	printk("Pong [%s] (on channel %d [data %d, %d])\n", coreA ? "core A" : "core B", channel,
	       *((uint32_t *)data->data), data->size);
}

static void tx_callback(const struct device *dev, uint32_t channel, void *user_data,
			struct mbox_msg *data)
{
	printk("--> TX DONE (channel : %d)\n", channel);
}

__attribute__((section(".cy_sharedmem"))) uint32_t data;

int main(void)
{
	const struct device *dev;

	data = 0;

	printk("Hello from APP [%s]\n", coreA ? "core A" : "core B");

	dev = DEVICE_DT_GET(DT_NODELABEL(mbox0));

	if (mbox_register_callback(dev, RX_ID, rx_callback, NULL)) {
		printk("mbox_register_callback() error\n");
		return 0;
	}

	if (mbox_register_callback(dev, TX_ID, tx_callback, NULL)) {
		printk("mbox_register_callback() error\n");
		return 0;
	}

	if (mbox_set_enabled(dev, RX_ID, 1)) {
		printk("mbox_set_enable() error\n");
		return 0;
	}

	while (1) {
		struct mbox_msg msg = {.data = &data, .size = sizeof(data)};

		printk("Ping [%s] (on channel %d)\n", coreA ? "core A" : "core B", TX_ID);

		if (mbox_send(dev, TX_ID, &msg) < 0) {
			printk("mbox_send() error [%s]\n", coreA ? "core A" : "core B");
		} else {
			data++;
		}
		k_sleep(K_MSEC(1000));
	}

	return 0;
}
```
